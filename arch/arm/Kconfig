## arch/arm/Kconfig
```kconfig
menu "ARM architecture"
	depends on ARM

config SYS_ARCH
	default "arm"

config ARM64
	bool

choice
	prompt "Target select"

config ROCKCHIP_ARCH32
	bool "Support Rockchip arch32 SOC"

config ROCKCHIP_ARCH64
	bool "Support Rockchip arch64 SOC"
	select ARM64

config ARCH_UNIPHIER
	bool "Panasonic UniPhier platform"
endchoice

source "arch/arm/cpu/armv7/rk32xx/Kconfig"

source "arch/arm/cpu/armv8/rk33xx/Kconfig"

endmenu
```

## board/rockchip/common/Kconfig
```kconfig
menu "RK Common Config"

config RM_RAMDISK_LOAD
	tristate "loader root from flash for linux"
	default n

config DOUBLE_OSBOOT
	tristate "Use Double-OS Boot"
	default n
endmenu
```
